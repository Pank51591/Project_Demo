//************************************************************
//  Copyright (c)  
//	FileName	  : main.c
//	Function	  : Main Function
//  Instructions  : Contains the MCU initialization function and its H file
//************************************************************
/********************Includes************************************************************************/
#include "SC_Init.h"	// MCU initialization header file, including all firmware library header files
#include "SC_it.h"
#include "..\Drivers\SCDriver_list.h"
#include "HeadFiles\SysFunVarDefine.h"
#include "ir.h"
/**************************************Generated by EasyCodeCube*************************************/
extern uint8_t head1080usflag;
extern uint8_t after720usflag;
uint8_t toggle;

/*************************************.Generated by EasyCodeCube.************************************/
/*****************************************************************************************************
* Function Name: main
* Description  : This function implements main function.
* Arguments    : None
* Return Value : None
******************************************************************************************************/
void main(void)
{	
 
    SC_Init();
	
    while(1)
    {
        if(head1080usflag | after720usflag)
        {
            if(toggle)
            {
                toggle = 0;
                GPIO_WriteLow(GPIO5, GPIO_PIN_4);
            }
            else
            {
                toggle = 1;
                GPIO_WriteHigh(GPIO5, GPIO_PIN_4);							
            }
            ir_receive_pocess();
        }
    }
}



