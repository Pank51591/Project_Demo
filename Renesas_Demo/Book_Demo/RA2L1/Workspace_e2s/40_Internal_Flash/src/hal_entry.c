#include "hal_data.h"

FSP_CPP_HEADER
void R_BSP_WarmStart(bsp_warm_start_event_t event);
FSP_CPP_FOOTER


/* 用户头文件包含 */
#include "led/bsp_led.h"
#include "debug_uart/bsp_debug_uart.h"
#include "internal_flash/bsp_internal_flash.h"


extern volatile bool code_flash_enable;
extern volatile bool data_flash_enable;


/*******************************************************************************************************************//**
 * main() is generated by the RA Configuration editor and is used to generate threads if an RTOS is used.  This function
 * is called by main() when no RTOS is used.
 **********************************************************************************************************************/
void hal_entry(void)
{
    /* TODO: add your own code here */

    LED_Init();         // LED 初始化
    Debug_UART1_Init(); // SCI1 UART 调试串口初始化

    /* Flash 模块初始化 */
    FLASH_LP_Init();

    printf("这是一个内部 Code / Data Flash 的使用例程\r\n");
    printf("打开串口助手发送以下指令，对 Flash 进行相应的操作\r\n");
    printf("\t指令   ------  操作\r\n");
    printf("\t 0   ------  操作 Code Flash\r\n");
    printf("\t 1   ------  操作 Data Flash\r\n");
    printf("\t=======================================\r\n\r\n");

    while(1)
    {
        if (true == code_flash_enable)
        {
            code_flash_enable = false;

            /* 测试 Code Flash */
            printf("测试 Code Flash...\r\n");
            FLASH_LP_CodeFlash_Operation();
        }

        if (true == data_flash_enable)
        {
            data_flash_enable = false;

            /* 测试 Data Flash */
            printf("测试 Data Flash...\r\n");
            FLASH_LP_DataFlash_Operation();

            /* 测试 Data Flash BGO */
//            printf("测试 Data Flash BGO...\r\n");
//            FLASH_LP_DataFlash_BGO_Operation();
        }

        LED1_TOGGLE;
        R_BSP_SoftwareDelay(500, BSP_DELAY_UNITS_MILLISECONDS);
    }


#if BSP_TZ_SECURE_BUILD
    /* Enter non-secure code */
    R_BSP_NonSecureEnter();
#endif
}

/*******************************************************************************************************************//**
 * This function is called at various points during the startup process.  This implementation uses the event that is
 * called right before main() to set up the pins.
 *
 * @param[in]  event    Where at in the start up process the code is currently at
 **********************************************************************************************************************/
void R_BSP_WarmStart(bsp_warm_start_event_t event)
{
    if (BSP_WARM_START_RESET == event)
    {
#if BSP_FEATURE_FLASH_LP_VERSION != 0

        /* Enable reading from data flash. */
        R_FACI_LP->DFLCTL = 1U;

        /* Would normally have to wait tDSTOP(6us) for data flash recovery. Placing the enable here, before clock and
         * C runtime initialization, should negate the need for a delay since the initialization will typically take more than 6us. */
#endif
    }

    if (BSP_WARM_START_POST_C == event)
    {
        /* C runtime environment and system clocks are setup. */

        /* Configure pins. */
        R_IOPORT_Open (&g_ioport_ctrl, g_ioport.p_cfg);
    }
}

#if BSP_TZ_SECURE_BUILD

BSP_CMSE_NONSECURE_ENTRY void template_nonsecure_callable ();

/* Trustzone Secure Projects require at least one nonsecure callable function in order to build (Remove this if it is not required to build). */
BSP_CMSE_NONSECURE_ENTRY void template_nonsecure_callable ()
{

}
#endif
