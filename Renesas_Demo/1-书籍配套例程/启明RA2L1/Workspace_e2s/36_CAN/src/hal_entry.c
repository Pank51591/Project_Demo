#include "hal_data.h"

FSP_CPP_HEADER
void R_BSP_WarmStart(bsp_warm_start_event_t event);
FSP_CPP_FOOTER


/* 用户头文件包含 */
#include "led/bsp_led.h"
#include "debug_uart/bsp_debug_uart.h"
#include "can/bsp_can.h"


/* 外部变量和函数声明 */
extern volatile bool can_senddata_enable;
extern volatile bool can_tx_complete_flag;
extern volatile bool can_rx_complete_flag;
extern can_frame_t can_tx_frame;
extern can_frame_t can_rx_frame;
extern uint8_t can_rx_msg[CAN_FRAME_TRANSMIT_DATA_BYTES];


/*******************************************************************************************************************//**
 * main() is generated by the RA Configuration editor and is used to generate threads if an RTOS is used.  This function
 * is called by main() when no RTOS is used.
 **********************************************************************************************************************/
void hal_entry(void)
{
    /* TODO: add your own code here */
    fsp_err_t err = FSP_SUCCESS;

    //初始化CGC时钟管理模块
    err = R_CGC_Open (&g_cgc0_ctrl, &g_cgc0_cfg);
    if (FSP_SUCCESS != err)
    {
        while(1);
    }
    //启动外部晶振
    err = R_CGC_ClockStart (&g_cgc0_ctrl, CGC_CLOCK_MAIN_OSC, NULL);
    if (FSP_SUCCESS != err)
    {
        while(1);
    }

    LED_Init();         // LED 初始化
    Debug_UART1_Init(); // SCI1 UART 调试串口初始化

    /* CAN 模块初始化 */
    CAN_Init();

    printf("这是一个 CAN 通讯例程\r\n");
    printf("打开串口助手发送以下指令，对 CAN 进行相应的操作\r\n");
    printf("\t指令   ------  操作\r\n");
    printf("\t 0   ------  CAN 发送数据帧\r\n");
    printf("\t=======================================\r\n\r\n");


    while(1)
    {
        if (true == can_senddata_enable)
        {
            can_senddata_enable = false; //清零标志位

            /* 测试从 CAN 发送到另一个 CAN（另一块板子） */
            CAN_Operation();
        }

        if (true == can_rx_complete_flag)
        {
            can_rx_complete_flag = false; //清零标志位

            printf("接收到“TXD_MESG”消息\r\n");
            /* 发送 “RXD_MESG” 应答消息作为回复 */

            can_tx_frame.id               = CAN_DESTINATION_MAILBOX_3;
            can_tx_frame.type             = CAN_FRAME_TYPE_DATA;
            can_tx_frame.data_length_code = CAN_FRAME_TRANSMIT_DATA_BYTES;

            /* copy the tx data frame with RXD_MESG */
            memcpy((uint8_t*)&can_tx_frame.data[0], (uint8_t*)&can_rx_msg[0], CAN_FRAME_TRANSMIT_DATA_BYTES);

            /* transmit the data from mail box #0 with tx_frame */
            R_CAN_Write(&g_can0_ctrl, CAN_MAILBOX_NUMBER_0, &can_tx_frame);

            /* 等待传输完成 */
            while (true != can_tx_complete_flag);
            can_tx_complete_flag = false;
            printf("应答消息“RXD_MESG”传输完成\r\n");
        }
    }


#if BSP_TZ_SECURE_BUILD
    /* Enter non-secure code */
    R_BSP_NonSecureEnter();
#endif
}

/*******************************************************************************************************************//**
 * This function is called at various points during the startup process.  This implementation uses the event that is
 * called right before main() to set up the pins.
 *
 * @param[in]  event    Where at in the start up process the code is currently at
 **********************************************************************************************************************/
void R_BSP_WarmStart(bsp_warm_start_event_t event)
{
    if (BSP_WARM_START_RESET == event)
    {
#if BSP_FEATURE_FLASH_LP_VERSION != 0

        /* Enable reading from data flash. */
        R_FACI_LP->DFLCTL = 1U;

        /* Would normally have to wait tDSTOP(6us) for data flash recovery. Placing the enable here, before clock and
         * C runtime initialization, should negate the need for a delay since the initialization will typically take more than 6us. */
#endif
    }

    if (BSP_WARM_START_POST_C == event)
    {
        /* C runtime environment and system clocks are setup. */

        /* Configure pins. */
        R_IOPORT_Open (&g_ioport_ctrl, g_ioport.p_cfg);
    }
}

#if BSP_TZ_SECURE_BUILD

BSP_CMSE_NONSECURE_ENTRY void template_nonsecure_callable ();

/* Trustzone Secure Projects require at least one nonsecure callable function in order to build (Remove this if it is not required to build). */
BSP_CMSE_NONSECURE_ENTRY void template_nonsecure_callable ()
{

}
#endif
